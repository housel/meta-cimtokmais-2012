## conf/layer.conf
```bitbake
# We have a conf and classes directory, append to BBPATH
BBPATH .= ":${LAYERDIR}"

# We have a recipes directory, add to BBFILES
BBFILES += "${LAYERDIR}/recipes*/*/*.bb ${LAYERDIR}/recipes*/*/*.bbappend"

BBFILE_COLLECTIONS += "meta-cimtokmais-2012"
BBFILE_PATTERN_meta-housel := "^${LAYERDIR}/"
BBFILE_PRIORITY_meta-housel = "99"

# Set a variable to get to the top of the metadata location
ROSCOEBASE := '${@os.path.normpath("${LAYERDIR}")}'
```
